VERSION ""

NS_ :

BS_:

BU_:
VAL_TABLE_ DebugState 6 "Aborted" 5 "Calibrated " 4 "Cal_In_Progress" 3 "Wait_For_Start" 2 "Pause" 1 "Cal_Check" 0 "Idle" ;
VAL_TABLE_ FNRP 3 "P" 2 "R" 1 "F" 0 "N" ;

BO_ 802 Trans_Faults: 8 Vector__XXX
 SG_ PTO_Error_Critical m1 : 2|16@1+ (1,0) [0|65535] "" Vector__XXX
 SG_ TransError_NonCritical3 m1 : 18|16@1+ (1,0) [0|65535] "" Vector__XXX
 SG_ TransError_NonCritical2 m0 : 34|16@1+ (1,0) [0|65535] "" Vector__XXX
 SG_ TransError_NonCritical1 m0 : 18|16@1+ (1,0) [0|65535] "" Vector__XXX
 SG_ TransError_Critical m0 : 2|16@1+ (1,0) [0|65535] "" Vector__XXX
 SG_ FaultMux M : 0|2@1+ (1,0) [0|3] "" Vector__XXX

BO_ 801 ClutchCurrents: 8 Vector__XXX
 SG_ ZeroLeakValve_DutyCycle m1 : 46|8@1+ (1,0) [0|100] "" Vector__XXX
 SG_ BypassValve_DutyCycle m1 : 38|8@1+ (1,0) [0|100] "" Vector__XXX
 SG_ PropValve_DutyCycle m1 : 30|8@1+ (1,0) [0|100] "" Vector__XXX
 SG_ Cal_Clutch_Current m1 : 20|10@1+ (1,0) [0|1023] "mA" Vector__XXX
 SG_ REV_Clutch_Cmd m0 : 50|10@1+ (1,0) [0|1023] "mA" Vector__XXX
 SG_ PTO_Clutch_Fbk m1 : 10|10@1+ (1,0) [0|1023] "mA" Vector__XXX
 SG_ Mux M : 62|2@1+ (1,0) [0|3] "" Vector__XXX
 SG_ REV_Clutch_Fbk m0 : 40|10@1+ (1,0) [0|1023] "mA" Vector__XXX
 SG_ PTO_Clutch_Cmd m1 : 0|10@1+ (1,0) [0|1023] "mA" Vector__XXX
 SG_ MFD_Clutch_Fbk m0 : 30|10@1+ (1,0) [0|1023] "mA" Vector__XXX
 SG_ MFD_Clutch_Cmd m0 : 20|10@1+ (1,0) [0|1023] "mA" Vector__XXX
 SG_ FWD_Clutch_Fbk m0 : 10|10@1+ (1,0) [0|1023] "mA" Vector__XXX
 SG_ FWD_Clutch_Cmd m0 : 0|10@1+ (1,0) [0|1023] "mA" Vector__XXX

BO_ 800 IO: 8 Vector__XXX
 SG_ LightRotarySwitch m1 : 42|2@1+ (1,0) [0|3] "" Vector__XXX
 SG_ HVAC_FanSpeed m1 : 39|3@1+ (1,0) [0|7] "" Vector__XXX
 SG_ HazardLight_State m0 : 61|1@1+ (1,0) [0|1] "" Vector__XXX
 SG_ ClutchSwitchState m0 : 58|1@1+ (1,0) [0|1] "" Vector__XXX
 SG_ R_BrakeSwitch m0 : 60|1@1+ (1,0) [0|1] "" Vector__XXX
 SG_ L_BrakeSwitch m0 : 59|1@1+ (1,0) [0|1] "" Vector__XXX
 SG_ Ebrake_pcnt m1 : 32|7@1+ (1,0) [0|127] "" Vector__XXX
 SG_ U_code m1 : 24|8@1+ (1,0) [0|255] "" Vector__XXX
 SG_ TransOutSpeed_RPM m1 : 0|12@1+ (1,0) [0|4095] "" Vector__XXX
 SG_ PTO_Speed_RPM m1 : 12|12@1+ (1,0) [0|4095] "" Vector__XXX
 SG_ IO_Mux M : 62|2@1+ (1,0) [0|3] "" Vector__XXX
 SG_ RangeSwitch m0 : 57|1@1+ (1,0) [0|1] "" Vector__XXX
 SG_ GearSwitch m0 : 56|1@1+ (1,0) [0|1] "" Vector__XXX
 SG_ REV_NVM_Write m0 : 46|10@1+ (1,0) [0|1023] "mA" Vector__XXX
 SG_ FWD_NVM_Write m0 : 36|10@1+ (1,0) [0|1023] "mA" Vector__XXX
 SG_ Trans_Input_Torque m0 : 28|8@1+ (1,0) [0|255] "" Vector__XXX
 SG_ Trans_Input_Speed m0 : 17|11@1+ (2,0) [0|4094] "rpm" Vector__XXX
 SG_ FNRP m0 : 15|2@1+ (1,0) [0|3] "" Vector__XXX
 SG_ ClutchPedal m0 : 7|8@1- (1,0) [-128|127] "" Vector__XXX
 SG_ Calib_State_Status_Debug m0 : 4|3@1+ (1,0) [0|7] "" Vector__XXX
 SG_ Cal_Switch2 m0 : 2|2@1+ (1,0) [0|3] "" Vector__XXX
 SG_ Cal_switch1 m0 : 1|1@1+ (1,0) [0|1] "" Vector__XXX
 SG_ Cal_Mode m0 : 0|1@1+ (1,0) [0|1] "" Vector__XXX

BA_DEF_  "BusType" STRING ;
BA_DEF_DEF_  "BusType" "CAN";
VAL_ 800 FNRP 3 "P" 2 "R" 1 "F" 0 "N" ;
VAL_ 800 Calib_State_Status_Debug 6 "Aborted" 5 "Calibrated " 4 "Cal_In_Progress" 3 "Wait_For_Start" 2 "Pause" 1 "Cal_Check" 0 "Idle" ;
